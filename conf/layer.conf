## conf/layer.conf
```bitbake
# We have a conf and classes directory, add to BBPATH
BBPATH := "${BBPATH}:${LAYERDIR}"

# We have an images and various recipe-* directories, add to BBFILES
BBFILES := "${BBFILES} ${LAYERDIR}/*/*.bb ${LAYERDIR}/*/*.bbappend"
	
BBFILE_COLLECTIONS += "x32"
BBFILE_PATTERN_x32 := "^${LAYERDIR}/"
BBFILE_PRIORITY_x32 = "8"

PREFERRED_PROVIDER_virtual/kernel = "linux-korg-3.1"
PREFERRED_PROVIDER_kernel-base = "linux-korg-3.1"
#Disable other kernel recipes
BBMASK = "/linux-(yocto|dummy)"
#BBMASK .= "|eglibc"

TCLIBC ?= "eglibc"
GCCVERSION ?= "4.7.0"
SDKGCCVERSION ?= "4.7.0"
GLIBCVERSION ?= "2.14"
EGLIBCVERSION ?= "2.14"
LINUXLIBCVERSION ?= "3.1"

BASE_LIB_tune-x86-64-x32 = "libx32"
BASE_LIB_tune-core2-64-x32 = "libx32"
```
